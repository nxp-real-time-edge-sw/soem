## Kconfig
```kconfig
menu "SOEM"
    config MCUX_COMPONENT_middleware.soem.enet
        bool "enet"
        
    if MCUX_COMPONENT_middleware.soem.enet
        choice
            prompt "enet anyOf 1"
            default MCUX_DEPENDENCY_COMPONENT_middleware.soem.enet_DEPEND_ANYOF_1_OPTION_1
            config MCUX_DEPENDENCY_COMPONENT_middleware.soem.enet_DEPEND_ANYOF_1_OPTION_1
                bool "Select MCUX_COMPONENT_middleware.baremetal"
            config MCUX_DEPENDENCY_COMPONENT_middleware.soem.enet_DEPEND_ANYOF_1_OPTION_2
                bool "Select MCUX_COMPONENT_middleware.freertos-kernel"
                select MCUX_COMPONENT_middleware.freertos-kernel
        endchoice
    endif
    config MCUX_COMPONENT_middleware.soem.netc
        bool "netc"
        
    if MCUX_COMPONENT_middleware.soem.netc
        choice
            prompt "netc anyOf 1"
            default MCUX_DEPENDENCY_COMPONENT_middleware.soem.netc_DEPEND_ANYOF_1_OPTION_1
            config MCUX_DEPENDENCY_COMPONENT_middleware.soem.netc_DEPEND_ANYOF_1_OPTION_1
                bool "Select MCUX_COMPONENT_middleware.baremetal"
            config MCUX_DEPENDENCY_COMPONENT_middleware.soem.netc_DEPEND_ANYOF_1_OPTION_2
                bool "Select MCUX_COMPONENT_middleware.freertos-kernel"
                select MCUX_COMPONENT_middleware.freertos-kernel
        endchoice
    endif
    config MCUX_COMPONENT_middleware.soem.bm
        bool "bm"
        
    if MCUX_COMPONENT_middleware.soem.bm
        choice
            prompt "bm anyOf 1"
            default MCUX_DEPENDENCY_COMPONENT_middleware.soem.bm_DEPEND_ANYOF_1_OPTION_1
            config MCUX_DEPENDENCY_COMPONENT_middleware.soem.bm_DEPEND_ANYOF_1_OPTION_1
                bool "Select MCUX_COMPONENT_middleware.baremetal"
        endchoice
    endif
    config MCUX_COMPONENT_middleware.soem.freertos
        bool "freertos"
        
    if MCUX_COMPONENT_middleware.soem.freertos
        choice
            prompt "freertos anyOf 1"
            default MCUX_DEPENDENCY_COMPONENT_middleware.soem.freertos_DEPEND_ANYOF_1_OPTION_1
            config MCUX_DEPENDENCY_COMPONENT_middleware.soem.freertos_DEPEND_ANYOF_1_OPTION_1
                bool "Select MCUX_COMPONENT_middleware.freertos-kernel"
                select MCUX_COMPONENT_middleware.freertos-kernel
        endchoice
    endif
endmenu
```
